## apps/manager/Kconfig
```kconfig
#
# Copyright 2014, NICTA
#
# This software may be distributed and modified according to the terms of
# the BSD 2-Clause license. Note that NO WARRANTY is provided.
# See "LICENSE_BSD2.txt" for details.
#
# @TAG(NICTA_BSD)
#

menu    "Manager task for benchmarking tests"
        config APP_MANAGER 
        bool "system resouce manager"
        default y 
        depends on LIB_SEL4 && LIB_MUSL_C 
        help 
             Partitioning system resources and setting up isolated domains. 
        
        config BENCH_UNTYPE_COUNT
        int "number of untyped grant to benchmarking thread" 
        default 1 
        depends on APP_MANAGER 
        help 
              allocate N number of untypes for each of the benchmarking thread. 



      config BENCH_UNTYPE_SIZEBITS
        int "the sizebit of the untypes allocated to benchmarking thread" 
        default 12
        depends on APP_MANAGER 
        help 
             allocating 1<<N untype for each of the benchmarking thread.  
        
       config MANAGER_MITIGATION 
        bool "setting up system for mitigating timing channels" 
        default n 
        depends on APP_MANAGER 
        help  
               setting up kernel objects, and endpointers for testing mitigation mechanisms. 
        

       config MANAGER_COLOUR_ONLY 
        bool "setting up system with coloured memory" 
        default n 
        depends on APP_MANAGER 
        help  
               setting up the user-level objects with coloured memory. 

  config MANAGER_UNCOLOUR_KERNEL
        bool "having a uncoloured kernel" 
        default n 
        depends on APP_MANAGER 
        help  
               setting up the user-level thread with uncoloured kernel.
      
        
       config MANAGER_IPC
        bool "ipc performance"
        default n 
        depends on APP_MANAGER 
        help 
             ipc benchmarks
       
        config MANAGER_IPC_SAME_COLOUR
        bool "Testing the IPC within a coloured domain" 
        default n 
        depends on MANAGER_IPC && MANAGER_MITIGATION
        help  
             The caller and receiver are built from a same cache colour (half of the L2 cache), 
             also using the same kernel image. 

     
      config MANAGER_CACHE_DIV_UNEVEN
        bool "Giving the testing thread n-1 of the L2 cache colours" 
        default n 
        depends on APP_MANAGER
        help  
               The benchmarking thread is  built from n-1 L2 cache colours.

        
        config MANAGER_PMU_COUNTER 
        bool "using pmu counter to monitor events" 
        default n 
        depends on APP_MANAGER 
        help 
              enable pmu counters 


        config MANAGER_CACHE_FLUSH 
        bool "cost of flushing caches"
        default n 
        depends on APP_MANAGER 
        help 
            see timing channel benchmarks 
        
        
        config MANAGER_FUNC_TESTS 
        bool "functional correctness benchmark" 
        default n 
        depends on APP_MANAGER 
        help  
             testing the multikernel feature, including creation, kernel switch, deletion, multicore, etc. 

        config MANAGER_COVERT_BENCH 
        bool "covert channel benchmarks" 
        default n 
        depends on APP_MANAGER 
        help 
            enable covert channel benchmarks 

        config MANAGER_SPLASH_BENCH
        bool "splash benchmarks" 
        default n 
        depends on APP_MANAGER 
        help 
             running splash-2 benchmarks 

        config MANAGER_DCACHE_ATTACK 
        bool "L1 dcache attack" 
        default n 
        depends on MANAGER_COVERT_BENCH  
        help 
            see timing channel benchmarks


       config MANAGER_HUGE_PAGES
       bool "setting up huge pages for the benchmarking thread"
       default n 
       depends on APP_MANAGER
       help 
           manager sets huge pages for the benchmarking thread, size is defined in the bench_common.h, passing pointer to benchmarking thread for the morecore area. 

endmenu
```

## apps/side-bench/Kconfig
```kconfig
#
# Copyright 2014, NICTA
#
# This software may be distributed and modified according to the terms of
# the BSD 2-Clause license. Note that NO WARRANTY is provided.
# See "LICENSE_BSD2.txt" for details.
#
# @TAG(NICTA_BSD)
#

menu   "Timing Channel Benchmarks"
       config APP_SIDE_BENCH 
        bool "benchmarking thread"
        default y 
        depends on LIB_SEL4 && LIB_MUSL_C 
        help 
             a seperate benchmarking thread for measuring chosen features.

        config BENCH_CACHE_FLUSH 
        bool "cost of flushing caches"
        default n 
        depends on APP_SIDE_BENCH 
        help 
             The cache flushing benchmark. 
             
         choice 
               prompt "types:"
               depends on BENCH_CACHE_FLUSH
        
               config BENCH_CACHE_FLUSH_NOTHING
               bool "idle"
             
               config BENCH_CACHE_FLUSH_L1_CACHES
               bool "L1D attack"
               
               config BENCH_CACHE_FLUSH_L1_CACHES_INSTRUCTION
               bool "L1I attack"
               
               config BENCH_CACHE_FLUSH_ATTACK
               bool "LLC attack"
        
               config BENCH_CACHE_FLUSH_ALL_CACHES 
               bool "probing LLC buffer"

               config BENCH_CACHE_FLUSH_L2_CACHES
               bool "L2 attack (x86 only)"

          endchoice
              
        config BENCH_DCACHE_ATTACK 
        bool "simulate the L1 dcache attack (Tromer_OS_10)"
        depends on APP_SIDE_BENCH 
        default n 
        help 
              reply the prime + probe attack published in Tromer_OS_10, extracting AES private keys. synchronous known-data attack.


       config BENCH_IPC  
       bool "ipc benchmarking" 
       depends on APP_SIDE_BENCH 
       default n 
       help 
           enable the ipc benchmarking functions 

        config BENCH_PMU_COUNTER 
        bool "using pmu counter to monitor events" 
        default n 
        depends on APP_SIDE_BENCH
        help 
              enable pmu counters 

       config BENCH_COVERT
       bool "covert channel benchmark"
       default n 
       depends on APP_SIDE_BENCH 
       help 
             a covert channel benchmark on various hardware components
      choice 
               prompt "attack model"
               depends on BENCH_COVERT
               config BENCH_COVERT_L1D 
               bool "L1 data cache" 
               
               config BENCH_COVERT_L1I 
               bool "L1 instruction cache"

               config BENCH_COVERT_L2 
               depends on ARCH_X86
               bool "L2 cache"

               config BENCH_COVERT_LLC 
               depends on ARCH_ARM
               bool "LLC"

               config BENCH_COVERT_LLC_KERNEL_SCHEDULE 
               bool "determinisitc kernel switching with LLC buffer"

               config BENCH_COVERT_TLB 
               bool "unified tlb"
               
               config BENCH_COVERT_BTB
               bool "branch target buffer"

               config BENCH_COVERT_BP
               bool "Branch prediction"
               
               config BENCH_COVERT_TIMER
               bool "Timer interrupt (HIGH)"

               config BENCH_COVERT_LLC_KERNEL 
               bool "a covert channel through a shared kernel"

      endchoice

      config BENCH_DATA_POINTS
      int "total number of random data points from high domain"
      default 409600
      depends on BENCH_COVERT
      help
           number of data points collected, used by both high and low
      
     
      config BENCH_COVERT_L1D_WRITE
      bool   "L1D covert channel with writes"
      default n
      depends on BENCH_COVERT_L1D
      help  
             using writes for accessing the probing buffer in the L1D cache channel 

      config BENCH_COVERT_L1I_REWRITE
      bool   "rewrite the L1I probe buffer"
      default n
      depends on BENCH_COVERT_L1I
      help  
             read then writeback the L1I probing buffer after every L1I probe

      config BENCH_COVERT_L1I_PROB_VADDR
      bool   "the trojan and spy uses different vaddr for probing"
      default n
      depends on BENCH_COVERT_L1I
      help  
             The trojan and spy uses different virtual address range for building 
             the probing buffer.


      config MASTIK_ATTACK
      bool "multicore cache-based timing attack"
      default n 
      depends on APP_SIDE_BENCH 
      help 
           attack used as data61+ demo extened as multicore benchmark

       choice 
             prompt "attack format" 
             depends on MASTIK_ATTACK
             config MASTIK_ATTACK_COVERT 
             bool "covert" 
             config MASTIK_ATTACK_SIDE 
             bool "side"
       endchoice

       config BENCH_SPLASH_MORECORE 
       bool "overwirte the lib morecore allocation"
       default n 
       depends on BENCH_SPLASH 
       help  
            overwrite the more core allocation configured in the lib c sys

       config BENCH_SPLASH
       bool "splash-2 benchmark"
       default n 
       depends on APP_SIDE_BENCH 
       help 
             a ported splash-2 benchmark
      choice 
               prompt "run:"
               depends on BENCH_SPLASH
               config BENCH_SPLASH_FFT 
               bool "fft" 

               config BENCH_SPLASH_CHOLESKY 
               bool "cholesky" 

               config BENCH_SPLASH_LU
               bool "lu" 
               
               config BENCH_SPLASH_RADIX
               bool "radix" 

               config BENCH_SPLASH_BARNES
               bool "barnes" 

               config BENCH_SPLASH_FMM
               bool "fmm" 

               config BENCH_SPLASH_OCEAN
               bool "ocean" 

               
               config BENCH_SPLASH_RADIOSITY
               bool "radiosity" 


               config BENCH_SPLASH_RAYTRACE
               bool "raytrace" 


               config BENCH_SPLASH_WATER_NSQUARED
               bool "water-nsquared" 

               config BENCH_SPLASH_WATER_SPATIAL
               bool "water-spatial" 

      endchoice


 endmenu 
```
